/dts-v1/;
/plugin/;
/ {
	fragment@0 {
		target = <&spi0>;
			__overlay__ {
			#address-cells = <1>;
			#size-cells = <0>;
			status = "okay";
			spi_device: spi_device@0 {
			compatible = "fb_st7735fb, st7735fb";
			reg = <0>;
			spi-max-frequency = <12000000>;
			dc-gpios = <&gpio  8 0>;
			cs-gpios = <&gpio 24 0>;
			reset-gpios = <&gpio 23 0>;
			};
		};
	};
};
